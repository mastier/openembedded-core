## meta/conf/machine/qemuarm.conf
```bitbake
#@TYPE: Machine
#@NAME: arm_versatile_926ejs
#@DESCRIPTION: arm_versatile_926ejs

require conf/machine/include/qemu.inc
require conf/machine/include/tune-arm926ejs.inc
#require conf/machine/include/tune-arm1136jf-s.inc

KERNEL_IMAGETYPE = "zImage"

SERIAL_CONSOLES = "115200;ttyAMA0 115200;ttyAMA1"

QEMU_MAHINE_SUBTYPE = "-machine versatilepb"
QEMU_SYSTEM_OPTIONS = "-no-reboot"
QEMU_KERNEL_OPTIONS = "console=ttyAMA0,115200 console=tty"
```
